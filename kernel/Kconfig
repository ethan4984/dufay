## kernel/Kconfig
```kconfig
mainmenu "Dufay Kernel Configuration"


choice
    prompt "CPU Architecture"
    default ARCH_AMD64

    config ARCH_AMD64
        bool "amd64"
        help
          Enable this option to select the AMD64 (x86_64) architecture.
        
    config ARCH_AARCH64
        bool "aarch64"
        help
          Enable this option to select the AARCH64 architecture.

endchoice

choice
    prompt "Scheduling Algorithm"
    default SCHED_ULE

    config SCHED_ULE
        bool "ULE"
        help
          Enable this option to select the ULE-like scheduler.
        
    config SCHED_RR
        bool "Round-Robin"
        help
          Enable this option to select the Round-Robin scheduler.

endchoice

choice
    prompt "Build toolchain"
    default LLVM 

    config LLVM 
        bool "LLVM"
        help
          Enable this option to select an LLVM-based toolchain.
        
    config GCC
        bool "GCC"
        help
          Enable this option to select a GCC-based toolchain.
endchoice
```
